## conf/layer.conf
```bitbake
# We have a conf and classes directory, add to BBPATH
BBPATH .= ":${LAYERDIR}"

# We have recipes-* directories, add to BBFILES
BBFILES += "${LAYERDIR}/recipes-*/*/*.bb \
            ${LAYERDIR}/recipes-*/*/*.bbappend"

BBFILE_COLLECTIONS += "meta-s57"
BBFILE_PATTERN_meta-s57 = "^${LAYERDIR}/"
BBFILE_PRIORITY_meta-s57 = "7"

LAYERDEPENDS_meta-s57 = "core"
LAYERSERIES_COMPAT_meta-s57 = "mickledore"
```
